## Config.in
```kconfig
source "$BR2_EXTERNAL_TPM_CCA_PATH/package/cca-realm-measurements/Config.in"
source "$BR2_EXTERNAL_TPM_CCA_PATH/package/cca-workload-attestation/Config.in"
source "$BR2_EXTERNAL_TPM_CCA_PATH/package/keybroker-demo/Config.in"
source "$BR2_EXTERNAL_TPM_CCA_PATH/package/qemu-cca/Config.in"
source "$BR2_EXTERNAL_TPM_CCA_PATH/package/kvmtool-cca/Config.in"
source "$BR2_EXTERNAL_TPM_CCA_PATH/package/cca-libtpms/Config.in"
```

## package/cca-libtpms/Config.in
```kconfig
config BR2_PACKAGE_CCA_LIBTPMS
    bool "CCA libtpms"
	select BR2_PACKAGE_HOST_PKGCONF
    select BR2_PACKAGE_OPENSSL
	select BR2_PACKAGE_OPENSSL_FORCE_LIBOPENSSL
    help
      Library providing TPM functionality for swtpm.

      https://github.com/stefanberger/libtpms
```

## package/cca-realm-tpm-launcher/Config.in
```kconfig
config BR2_PACKAGE_CCA_REALM_TPM_LAUNCHER
    bool "cca-realm-tpm-launcher"
    help
      Installs a host-side init script (S50realm-tpm) that
      automatically launches the CCA Realm with swtpm at
      platform boot time.
```

## package/cca-swtpm-test/Config.in
```kconfig
config BR2_PACKAGE_CCA_TPM_TEST
    bool "CCA swtpm test"
    depends on BR2_PACKAGE_CCA_LIBTPMS
    help
      Simple C test program for libtpms API
      inside a CCA Realm.
```

## package/cca-swtpm/Config.in
```kconfig
config BR2_PACKAGE_CCA_SWTPM
    bool "CCA swtpm"
    select BR2_PACKAGE_CCA_LIBTPMS
    select BR2_PACKAGE_NET_TOOLS
    select BR2_PACKAGE_IPROUTE2
    help
      Software TPM emulator providing TPM2 functionality
      inside a CCA Realm via a Unix socket.

      https://github.com/stefanberger/swtpm
```

## package/cca-workload-attestation/Config.in
```kconfig
config BR2_PACKAGE_CCA_WORKLOAD_ATTESTATION
	bool "CCA Workload Attestation PoC"
	depends on BR2_PACKAGE_HOST_GO_TARGET_ARCH_SUPPORTS
	depends on BR2_PACKAGE_HOST_GO_TARGET_CGO_LINKING_SUPPORTS
	help
	  A proof-of-concept, self-contained executable that
	  demonstrates the use of CCA attestation in a number
	  of representative scenarios.

	  https://gitlab.com/Linaro/cca-public/cca-demos/cca-workload-attestation-poc
```
